  0x40,0x10,0x04,0x01,0x78,0x61,0x10,0x24,0x09,0x02,0x40,0x90,0x26,0x11,0x78,0x1E,0x10,0x90,0x08,0x04,
  0x02,0x01,0x00,0x42,0x1E,0x00,0x00,0x80,0x20,0x08,0x7A,0x21,0x90,0x24,0x09,0x02,0x40,0x90,0x22,0x18,
  0x7A,0x1C,0x08,0x84,0x11,0x04,0x7F,0x10,0x04,0x00,0x84,0x1E,0x00,0x1C,0x82,0x1E,0x20,0x82,0x08,0x20,
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  0x00,0x80,0x20,0x08,0x02,0x03,0x00,0x1E,0x11,0x0F,0x00,0x00,0x00,0x00,0x00,0x00,0x00,0x00,0x00,
};
static const EnGlyphMeta EN_GLYPHS[95] PROGMEM = {
  {32,0,5,0,5,0,0},
  {33,0,6,12,6,0,-12},
  {34,9,7,12,7,0,-12},
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  {126,1287,13,7,13,0,-7},
};
constexpr int EN_GLYPH_COUNT = 95;
// ================================================================

// --------------------- Helpers ---------------------

