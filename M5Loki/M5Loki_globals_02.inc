  0x87,0xF9,0xF7,0x10,0x30,0x00,0x08,0x1C,0x0C,0x06,0x06,0x06,0x7E,0x7C,0x10,0x0C,0x00,0x00,0x20,0x1C,
  0x03,0x00,0x60,0x18,0x06,0x1F,0xE7,0xDC,0x10,0x60,0x60,0xC0,0x83,0x04,0x38,0xE1,0x00,0x10,0x18,0x06,
  0x03,0x00,0xE0,0xF8,0x40,0xE0,0xE0,0x40,0x00,0x10,0x60,0x00,0x83,0x03,0x06,0x04,0x18,0x21,0xC7,0x08,
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  0x80,0x97,0x80,0x10,0x10,0x30,0xFE,0xEE,0x00,0x48,0x78,
};
static const ArGlyphMeta AR_GLYPHS[120] PROGMEM = {
  {0x060C,0,5,4,5,0,-4},
  {0x061B,3,5,9,5,0,-9},
  {0x061F,9,7,12,7,0,-12},
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  {0xFE9E,427,12,14,11,0,-8},
