  {0xFE9F,448,10,9,10,0,-6},
  {0xFEA0,460,12,9,10,0,-6},
  {0xFEA1,474,10,14,10,0,-8},
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  {0xFEF4,1923,8,8,6,0,-5},
};
constexpr int AR_GLYPH_COUNT = 120;
// ================================================================

// ===================== EMBEDDED ENGLISH FONT ====================
// Fixed English reply font: DejaVu Sans, 16px.
struct EnGlyphMeta { uint8_t cp; uint16_t off; uint8_t w,h,adv; int8_t xo,yo; };
static const uint8_t EN_BITMAP[1299] PROGMEM = {
  0x20,0x82,0x08,0x20,0x82,0x08,0x00,0x02,0x08,0x48,0x91,0x22,0x40,0x00,0x00,0x00,0x00,0x00,0x00,0x00,
  0x06,0x40,0x22,0x01,0x30,0x7F,0xE0,0xC8,0x04,0x40,0x26,0x0F,0xFC,0x19,0x00,0x88,0x04,0xC0,0x04,0x01,
  0x01,0xF0,0xD2,0x24,0x09,0x01,0xC0,0x1C,0x04,0x81,0x22,0x58,0x7C,0x04,0x01,0x00,0x38,0x20,0x88,0x41,
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  0x00,0x00,0x00,0x00,0x00,0x00,0x00,0x00,0x1E,0x08,0xC0,0x10,0xFC,0x61,0x10,0x44,0x11,0x8C,0x3D,0x00,
