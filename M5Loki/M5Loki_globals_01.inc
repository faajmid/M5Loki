/*
  M5Loki - Open-Source AI Pet Firmware for M5StickC Plus2
  ---------------------------------------------------------

  Author: Fahad AlAjmi
  Email: faajmid@gmail.com
  GitHub: https://github.com/faajmid
  Instagram: @faajmid
  TikTok: @faajmid

  License: MIT
  Copyright (c) 2026 Fahad AlAjmi

  Permission is hereby granted, free of charge, to any person obtaining a copy
  of this software and associated documentation files (the "Software"), to deal
  in the Software without restriction, including without limitation the rights
  to use, copy, modify, merge, publish, distribute, sublicense, and/or sell
  copies of the Software, subject to the conditions in the LICENSE file.

  IMPORTANT:
  - Never commit your real Gemini API key.
  - Copy config.example.h to config.h and place your key there.
*/

struct ArForm;  // Forward declaration for Arduino auto-generated prototypes

// M5Loki v7.9 - brightness down fix + larger readable UI
#include <M5StickCPlus2.h>
#include "config.h"

// ================= FONT SETTINGS =================
// English and Arabic reply fonts are both embedded at 16px.
// This keeps both languages visually matched.
// =================================================

#include <WiFi.h>
#include <WiFiClientSecure.h>
#include <HTTPClient.h>
#include <Preferences.h>
#include <ArduinoJson.h>
#include <mbedtls/base64.h>
#include <esp_heap_caps.h>
#include <pgmspace.h>

#ifndef GEMINI_API_KEY
#error "Missing GEMINI_API_KEY. Copy config.example.h to config.h and add your Gemini API key."
#endif


// ===================== CHANGE THESE =====================
const char* GEMINI_MODEL   = "gemini-flash-lite-latest";
// ========================================================

uint16_t C_BG = TFT_BLACK;
uint16_t C_MAIN = 0x07FF;   // selected Loki accent
uint16_t C_DIM = 0x7BEF;
uint16_t C_TEXT = TFT_WHITE;

const uint16_t LOKI_COLORS[5] = {
  0x07FF, // cyan
  0x07E0, // green
  0xF81F, // magenta
  0xFFE0, // yellow
  0xFD20  // orange
};
int colorIndex = 0;
bool lightMode = false;
constexpr uint32_t SAMPLE_RATE = 16000;
constexpr uint32_t MAX_RECORD_MS = 6000;
constexpr size_t FRAME_SAMPLES = 320;
constexpr size_t MAX_SAMPLES = SAMPLE_RATE * MAX_RECORD_MS / 1000;
constexpr uint32_t SLEEP_MS = 10000;

enum Screen { FACE, CHAT, WIFI_LIST, KEYBOARD, CONNECTING, ERROR_SCREEN, MENU, APPEARANCE_MENU, TIME_SET, COLOR_SET, THEME_SET, BRIGHTNESS_SET, ABOUT_SCREEN };
enum Mood {
  NORMAL, HAPPY, LOVE, EXCITED, CURIOUS, SURPRISED,
  THINKING, LISTENING, SAD, WORRIED, ANGRY, DEAD, SLEEPY
};

Preferences prefs;
Screen screen = FACE;
Mood mood = NORMAL;

String chosenSSID, wifiPassword;
String transcriptText, replyText = "Hold M5 to talk";
String errorText;

uint32_t lastActivity = 0;
uint32_t reactionStarted = 0;
uint32_t recordStarted = 0;
uint32_t lastAnim = 0;

bool recording = false;
bool eyesClosed = false;
uint32_t nextBlinkAt = 0;
uint32_t blinkEndsAt = 0;
bool aHeld = false, bHeld = false, pHeld = false;
Mood reactionMood = HAPPY;       // Reaction chosen from the last conversation
bool showingReaction = false;    // True only when user asks to see the reaction
uint32_t lastBatteryDraw = 0;

enum SpecialAction { ACTION_NONE, ACTION_BIRTHDAY };
SpecialAction specialAction = ACTION_NONE;
bool birthdaySongPlayed = false;
bool birthdayPlaying = false;
int birthdayNoteIndex = 0;
uint32_t birthdayNextAt = 0;

int menuIndex = 0;
int appearanceIndex = 0;
int brightnessLevel = 180;
int timeField = 0;     // 0 = hour, 1 = minute
int setHour = 12;
int setMinute = 0;
uint32_t clockBaseMillis = 0;
int clockBaseMinutes = 12 * 60;


// M5StickC Plus2 top/power button is GPIO35, but the M5StickCPlus2
// wrapper exposes only BtnA and BtnB in some library versions.
// Therefore we read GPIO35 directly.
constexpr int TOP_BUTTON_PIN = 35;
bool topNow = false;
bool topPrevious = false;
bool topClickedEvent = false;
bool topHoldEvent = false;
bool topHoldSent = false;
uint32_t topPressedAt = 0;

int16_t* audio = nullptr;
size_t audioCount = 0;

constexpr int MAX_WIFI = 20;
String ssids[MAX_WIFI];
int rssis[MAX_WIFI];
bool secured[MAX_WIFI];
int networkCount = 0, networkCursor = 0;

const char* rows[] = {
  "1234567890-=",
  "qwertyuiop[]",
  "asdfghjkl;'!",
  "\\zxcvbnm,.?/"
};
int keyRow = 0, keyCol = 0;
constexpr int CONNECT_ROW = 4;


// ===================== EMBEDDED ARABIC FONT =====================
// Fixed Arabic reply font: Noto Sans Arabic Medium, 16px.
struct ArGlyphMeta { uint16_t cp; uint16_t off; uint8_t w,h,adv; int8_t xo,yo; };
static const uint8_t AR_BITMAP[1931] PROGMEM = {
  0x21,0x18,0xE0,0x31,0x18,0xC0,0x00,0x0C,0x60,0x7C,0xFF,0x06,0x06,0x0E,0x06,0x0C,0x18,0x00,0x60,0xC0,
  0x10,0xF1,0x82,0x06,0x47,0xBC,0x00,0x6B,0xE1,0x00,0x30,0xC3,0x0C,0x30,0xC3,0x0C,0x30,0xC0,0x79,0xF0,
  0x00,0x03,0x06,0x0C,0x18,0x30,0x60,0xC1,0x81,0xC3,0xC0,0x4E,0x86,0xC0,0x66,0x66,0x66,0x66,0x66,0x43,
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  0x80,0x78,0xFD,0xEF,0x0E,0x08,0x1C,0x0C,0x06,0x06,0x06,0x7E,0x7C,0x08,0x07,0x00,0xC0,0x18,0x06,0x01,
